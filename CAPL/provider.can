/*@!Encoding:1252*/

/* 
   Provider side CAPL application model for service 'Diagnostics'
   This model implements all methods and events of the service
*/

variables
{
  msTimer stateEventTimer; // Timer for event transmission
  int gReadDataCount;           // Number of test operations
}


on start
{
  // Set timer to cyclic interval of 1000 milliseconds
  setTimerCyclic(stateEventTimer, 1000);
}

on timer stateEventTimer
{
  $CommunicationObjects::Diagnostics.providerSide[Provider].State.ReadDataCount = gReadDataCount;
}

// Implementation for method 'ReadData'
on fct_called CommunicationObjects::Diagnostics.ReadData
{
  if (this.identifier == 0128)
{
  this.description = "Coolant Thermostat Error Detected";
}
else if (this.identifier == 0171)
{
  this.description = "System Too Lean Error Detected";
}
else if (this.identifier == 0172)
{
  this.description = "System Too Rich Error Detected";
}
else if (this.identifier == 0300)
{
  this.description = "Cylinder Misfire Detected";
}
else if (this.identifier == 0401)
{
  this.description = "Exhaust Gas Recirculation Flow Insufficient Detected";
}
else if (this.identifier == 0420)
{
  this.description = "Catalyst System Error Detected";
}
else if (this.identifier == 0440)
{
  this.description = "Emission Control System Malfunction Detected";
}
else
{
  this.description = "DTC code not recognised...";
}

  gReadDataCount++;                                 // Update counter
  this.ReturnCall();     

  // Update ReadDataField. This will also trigger the transmission of the field notification
  $CommunicationObjects::Diagnostics.providerSide[Provider].ReadDataField = this.description;
}