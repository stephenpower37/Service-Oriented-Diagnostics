/*@!Encoding:1252*/

/* 
   Consumer side CAPL application model for service 'Diagnostics'
   This model calls a method and prints the result
   Additionally, the value of the event 'State' is printed
*/



// Call method 'ReadData' of service 'Diagnostics' when key 'c' is pressed 
on key 'c'
{
  CommunicationObjects::Diagnostics.ReadData.CallAsync(0420);
}

// This handler is called when the return value of method 'ReadData' of service 'Diagnostics' is received
on fct_returned CommunicationObjects::Diagnostics.ReadData
{
  // Print result in the Write Window of CANoe
  write("Result of Test method: %f", this.description);
}

// This handler is called when the value of the event 'State' changed
on value_change CommunicationObjects::Diagnostics.consumerSide[Consumer,Provider].State
{
  write("State event received. ReadDataCount: %d",
         $CommunicationObjects::Diagnostics.consumerSide[Consumer,Provider].State.ReadDataCount);
}

// Call Field Getter 'ReadDataField' of service 'Diagnostics' when key 'g' is pressed 
on key 'g'
{
  //Get TestResult
  CommunicationObjects::Diagnostics.ReadDataField.Get.CallAsync();
}

// Call Field Setter 'ReadDataField' of service 'Diagnostics' when key 's' is pressed 
on key 's'
{
  //Set CalcResult to '0'
  CommunicationObjects::Diagnostics.ReadDataField.Set.CallAsync("DTC not recognised...");
}