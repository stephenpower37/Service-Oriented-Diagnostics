/*@!Encoding:1252*/

/* 
   Consumer side CAPL application model for service 'Diagnostics'
   This model calls a method and prints the result
   Additionally, the value of the event 'State' is printed
*/



// Call method 'Test' of service 'Diagnostics' when key 'c' is pressed 
on key 'c'
{
  CommunicationObjects::Diagnostics.Test.CallAsync();
}

// This handler is called when the return value of method 'Test' of service 'Diagnostics' is received
on fct_returned CommunicationObjects::Diagnostics.Test
{
  // Print result in the Write Window of CANoe
  write("Result of Test method: %f", this.result);
}

// This handler is called when the value of the event 'State' changed
on value_change CommunicationObjects::Diagnostics.consumerSide[Consumer,Provider].State
{
  write("State event received. TestCount: %d",
         $CommunicationObjects::Diagnostics.consumerSide[Consumer,Provider].State.TestCount);
}

// Call Field Getter 'TestResult' of service 'Diagnostics' when key 'g' is pressed 
on key 'g'
{
  //Get TestResult
  CommunicationObjects::Diagnostics.TestResult.Get.CallAsync();
}

// Call Field Setter 'TestResult' of service 'Diagnostics' when key 's' is pressed 
on key 's'
{
  //Set CalcResult to '0'
  CommunicationObjects::Diagnostics.TestResult.Set.CallAsync(1);
}